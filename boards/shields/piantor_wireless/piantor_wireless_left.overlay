#include "piantor_wireless.dtsi"

&kscan0 {
    /* Left half col0..col5 (outer breakable pinky -> inner index) */
    col-gpios
        = <&pro_micro  6 GPIO_ACTIVE_HIGH> /* col0: U1.9  / P1.00 (breakable pinky col) */
        , <&pro_micro  7 GPIO_ACTIVE_HIGH> /* col1: U1.10 / P0.11 */
        , <&pro_micro 10 GPIO_ACTIVE_HIGH> /* col2: U1.13 / P0.09 */
        , <&pro_micro 16 GPIO_ACTIVE_HIGH> /* col3: U1.14 / P0.10 */
        , <&pro_micro 14 GPIO_ACTIVE_HIGH> /* col4: U1.15 / P1.11 */
        , <&pro_micro 15 GPIO_ACTIVE_HIGH> /* col5: U1.16 / P1.13 */
        ;
};
