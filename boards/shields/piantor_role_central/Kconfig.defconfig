## boards/shields/piantor_role_central/Kconfig.defconfig
```kconfig
if SHIELD_PIANTOR_ROLE_CENTRAL

config ZMK_SPLIT_ROLE_CENTRAL
    default y

config ZMK_STUDIO
    default y

endif
```

## boards/shields/piantor_role_central/Kconfig.shield
```kconfig
config SHIELD_PIANTOR_ROLE_CENTRAL
    def_bool $(shields_list_contains,piantor_role_central)
```

## boards/shields/piantor_tps43_central/Kconfig.defconfig
```kconfig
if SHIELD_PIANTOR_TPS43_CENTRAL

config INPUT
    default y

config I2C
    default y

config INPUT_TPS43
    default y

config ZMK_POINTING
    default y

endif
```

## boards/shields/piantor_tps43_central/Kconfig.shield
```kconfig
config SHIELD_PIANTOR_TPS43_CENTRAL
    def_bool $(shields_list_contains,piantor_tps43_central)
```

## boards/shields/piantor_wireless/Kconfig.defconfig
```kconfig
if SHIELD_PIANTOR_WIRELESS_LEFT || SHIELD_PIANTOR_WIRELESS_RIGHT

config ZMK_KEYBOARD_NAME
    default "Piantor TPS43"

config ZMK_SPLIT
    default y

endif
```

## boards/shields/piantor_wireless/Kconfig.shield
```kconfig
config SHIELD_PIANTOR_WIRELESS_LEFT
    def_bool $(shields_list_contains,piantor_wireless_left)

config SHIELD_PIANTOR_WIRELESS_RIGHT
    def_bool $(shields_list_contains,piantor_wireless_right)
```

## config/west.yml
```yaml
manifest:
  remotes:
    - name: zmkfirmware
      url-base: https://github.com/zmkfirmware
    - name: beekeeb
      url-base: https://github.com/beekeeb
    - name: ykiewang
      url-base: https://github.com/ykiewang
  projects:
    - name: zmk
      remote: zmkfirmware
      revision: main
      import: app/west.yml
    - name: zmk_driver_azoteq
      remote: beekeeb
      revision: main
    - name: zmk-keybeacon
      remote: ykiewang
      revision: v1.2.0
  self:
    path: config
```
